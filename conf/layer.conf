## conf/layer.conf
```bitbake
# We have a conf and classes directory, add to BBPATH
BBPATH .= ":${LAYERDIR}"

# We have recipes-* directories, add to BBFILES
BBFILES += "${LAYERDIR}/recipes-*/*/*.bb \
            ${LAYERDIR}/recipes-*/*/*.bbappend"

BBFILE_COLLECTIONS += "meta-snapcast"
BBFILE_PATTERN_meta-snapcast = "^${LAYERDIR}/"
BBFILE_PRIORITY_meta-snapcast = "6"

LAYERDEPENDS_meta-snapcast = "core"
LAYERSERIES_COMPAT_meta-snapcast = "zeus dunfell"
```
